## src/modules/px4_simulink_app/Kconfig
```kconfig
menuconfig MODULES_PX4_SIMULINK_APP
	bool "Simulink Application"
	default n
	---help---
		Enable support for Simulink

menuconfig USER_PX4_SIMULINK_APP
	bool "Simulink Application running as userspace module"
	default y
	depends on BOARD_PROTECTED && MODULES_PX4_SIMULINK_APP
	---help---
		Put PX4_SIMULINK_APP in userspace memory
```

## src/modules/px4_simulink_utils/Kconfig
```kconfig
menuconfig MODULES_PX4_SIMULINK_UTILS
	bool "Simulink Utility"
	default n
	---help---
		Enable support for Simulink

menuconfig USER_PX4_SIMULINK_UTILS
	bool "Simulink Utility running as userspace module"
	default y
	depends on BOARD_PROTECTED && MODULES_PX4_SIMULINK_UTILS
	---help---
		Put PX4_SIMULINK_UTILS in userspace memory
```
